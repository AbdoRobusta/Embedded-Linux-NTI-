## Custom Own DISTRO | Image/meta-abozaid/conf/distro/abozaid.conf
```bitbake
# =========================================================
# Custom Yocto Distribution - Abozaid Linux
# =========================================================
DISTRO = "abozaid"
DISTRO_NAME = "Abozaid Linux"
DISTRO_VERSION = "1.0"
DISTRO_CODENAME = "falcon"

# Inherit base poky configuration
include conf/distro/poky.conf

# Package management
PACKAGE_CLASSES = "package_rpm"

# Init system
DISTRO_FEATURES:append = " systemd wifi bluetooth"
VIRTUAL-RUNTIME_init_manager = "systemd"

# Graphics system
DISTRO_FEATURES:append = " wayland opengl"

# Branding
DISTRO_BRANDING = "Abozaid Linux"
MOTD = "Welcome to Abozaid Linux!"

# Compiler tuning
TCLIBC = "glibc"
SDKMACHINE = "x86_64"
```

## Layers/meta-tasks/conf/layer.conf
```bitbake
# We have a conf and classes directory, add to BBPATH
BBPATH .= ":${LAYERDIR}"

# We have recipes-* directories, add to BBFILES
BBFILES += "${LAYERDIR}/recipes-*/*/*.bb \
            ${LAYERDIR}/recipes-*/*/*.bbappend"
ABDO = "Abozaid"
BBFILE_COLLECTIONS += "meta-tasks"
BBFILE_PATTERN_meta-tasks = "^${LAYERDIR}/"
BBFILE_PRIORITY_meta-tasks = "6"

LAYERDEPENDS_meta-tasks = "core"
LAYERSERIES_COMPAT_meta-tasks = "kirkstone"
```
